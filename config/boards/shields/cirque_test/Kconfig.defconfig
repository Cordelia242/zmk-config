## config/boards/shields/cirque_test/Kconfig.defconfig
```kconfig
if SHIELD_CIRQUE_TEST

config ZMK_KEYBOARD_NAME
    default "Cirque Test"

endif
```

## config/boards/shields/corne_cirque/Kconfig.defconfig
```kconfig
if SHIELD_CORNE_CIRQUE_LEFT

config ZMK_KEYBOARD_NAME
    default "Corne Cirque"

config ZMK_SPLIT_ROLE_CENTRAL
    default y

endif

if SHIELD_CORNE_CIRQUE_LEFT || SHIELD_CORNE_CIRQUE_RIGHT

config ZMK_SPLIT
    default y

endif
```
